## board/freescale/magik2_plus/Kconfig
```kconfig
if TARGET_MAGIK2_PLUS

config SYS_BOARD
	default "magik2_plus"

config SYS_VENDOR
	default "freescale"

config SYS_SOC
	default "mx6"

config SYS_CONFIG_NAME
	default "magik2_plus"

endif
```

## configs/magik2_defconfig
```kconfig
CONFIG_SYS_EXTRA_OPTIONS="IMX_CONFIG=board/freescale/magik2_plus/magik2_40_60_default.cfg,MX6Q,SYS_USE_SPINOR"
CONFIG_ARM=y
CONFIG_TARGET_MAGIK2_PLUS=y
CONFIG_DM=y
CONFIG_DM_THERMAL=y
```
